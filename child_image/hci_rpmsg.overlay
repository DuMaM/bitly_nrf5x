
arduino_serial: &uart0 {
	//status = "okay";
	status = "disabled";
	compatible = "nordic,nrf-uarte";
	current-speed = <115200>;
	pinctrl-0 = <&uart0_default>;
	pinctrl-1 = <&uart0_sleep>;
	pinctrl-names = "default", "sleep";
	/delete-property/ rts-pin;
    /delete-property/ cts-pin;
	interrupts = < 0x13 0x5 >;
};