## lib/particle_button_and_leds/Kconfig
```kconfig
#
# Copyright (c) 2018 Nordic Semiconductor
#
# SPDX-License-Identifier: LicenseRef-Nordic-5-Clause
#

menuconfig PARTICLE_LIBRARY
	bool "Button and LED Library for Nordic DKs"
	select GPIO

if PARTICLE_LIBRARY

config PARTICLE_LIBRARY_BUTTON_SCAN_INTERVAL
	int "Scanning interval of buttons in milliseconds"
	default 10

config PARTICLE_LIBRARY_INVERT_BUTTONS
	bool "Invert buttons pins on DK"
	default y

config PARTICLE_LIBRARY_INVERT_LEDS
	bool "Invert LED pins on DK"
	default y

config PARTICLE_LIBRARY_DYNAMIC_BUTTON_HANDLERS
	bool "Enable the runtime assignable button handler API"
	default y

module = PARTICLE_LIBRARY
module-str = PARTICLE library
source "${ZEPHYR_BASE}/subsys/logging/Kconfig.template.log_config"

endif # PARTICLE_LIBRARY
```

## src/app_services/Kconfig.performance_test
```kconfig
#
# Copyright (c) 2019 Nordic Semiconductor ASA
#
# SPDX-License-Identifier: LicenseRef-Nordic-5-Clause
#

config BT_PERF_TEST
    bool "Performance test service"
    depends on BT_GATT_DM && BT_SCAN
    help
     Enable Nordic GATT performance test BLE service.

if BT_PERF_TEST

module = BT_PERF_TEST
module-str = PERF_TEST
source "${ZEPHYR_BASE}/subsys/logging/Kconfig.template.log_config"

endif # BT_PERF_TEST
```
